## boards/fractal/Kconfig.fractal
```kconfig
# Copyright (c) 2026 cdstudio
# SPDX-License-Identifier: Apache-2.0

config BOARD_FRACTAL
	select SOC_STM32H573XX
```

## boards/fractal/board.yml
```yaml
board:
  name: fractal
  full_name: cdstudio Fractal
  vendor: cdstudio
  socs:
    - name: stm32h573xx
```

## boards/shields/aquanode/Kconfig.defconfig
```kconfig
if SHIELD_AQUANODE

config GPIO
	default y

config I2C
	default y

config MFD
	default y

config ADC
	default y

endif
```

## boards/snake/Kconfig.snake
```kconfig
# Copyright (c) 2026 cdstudio
# SPDX-License-Identifier: Apache-2.0

config BOARD_SNAKE
	select SOC_ESP32_C6_WROOM_1U_N8
	select SOC_ESP32C6_HPCORE if BOARD_SNAKE_ESP32C6_HPCORE
	select SOC_ESP32C6_LPCORE if BOARD_SNAKE_ESP32C6_LPCORE
```

## boards/snake/board.yml
```yaml
board:
  name: snake
  full_name: cdstudio Snake
  vendor: cdstudio
  socs:
  - name: esp32c6
```

## dts/bindings/misc/cdstudio,aquanode-channels.yaml
```yaml
description: Irrigation channels of the aquanode carrier board, one child node per channel

compatible: "cdstudio,aquanode-channels"

properties:
  "#address-cells":
    type: int
    const: 1
  "#size-cells":
    type: int
    const: 0

child-binding:
  description: Irrigation channel numbered by its reg, with its valve output and its two analog inputs

  properties:
    reg:
      type: int
      required: true

    valve-gpios:
      type: phandle-array
      required: true

    io-channels:
      type: phandle-array
      required: true

    io-channel-names:
      type: string-array
      required: true
```
